## conf/layer.conf
```bitbake
# We have a conf and classes directory, add to BBPATH
BBPATH =. "${LAYERDIR}:"

# We have recipes-* directories, add to BBFILES
BBFILES += "${LAYERDIR}/recipes-*/*/*.bb \
            ${LAYERDIR}/recipes-*/*/*.bbappend"

BBFILE_COLLECTIONS += "containers"
BBFILE_PATTERN_containers = "^${LAYERDIR}/"
BBFILE_PRIORITY_containers = "70"
LAYERSERIES_COMPAT_containers = "dunfell"
```
